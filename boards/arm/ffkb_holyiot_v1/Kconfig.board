## boards/arm/ffkb_holyiot_v1/Kconfig.board
```kconfig
# Zaphod board configuration

# Copyright (c) 2020 Pete Johanson
# SPDX-License-Identifier: MIT

config BOARD_FFKB_HOLYIOT_V1
	bool "ffkb_holyiot_v1"
	depends on SOC_NRF52840_QIAA
```

## boards/arm/ffkb_holyiot_v1/ffkb_holyiot_v1_defconfig
```kconfig
# SPDX-License-Identifier: MIT

CONFIG_USB_DEVICE_MANUFACTURER="fingerpunch"
CONFIG_ZMK_KEYBOARD_NAME="ffkb holyiot"
CONFIG_USB_DEVICE_PRODUCT="ffkb holyiot"
CONFIG_ZMK_HID_CONSUMER_REPORT_USAGES_FULL=y

CONFIG_SOC_SERIES_NRF52X=y
CONFIG_SOC_NRF52840_QIAA=y

# Enable MPU
CONFIG_ARM_MPU=y

# enable GPIO
CONFIG_GPIO=y

# for leds, if configured
CONFIG_SPI=y

CONFIG_ZMK_SLEEP=y

CONFIG_USE_DT_CODE_PARTITION=y

CONFIG_MPU_ALLOW_FLASH_WRITE=y
CONFIG_NVS=y
CONFIG_SETTINGS_NVS=y
CONFIG_FLASH=y
CONFIG_FLASH_PAGE_LAYOUT=y
CONFIG_FLASH_MAP=y

# Enable Encoders
CONFIG_EC11=y
CONFIG_EC11_TRIGGER_GLOBAL_THREAD=y

# Enable underglow
CONFIG_ZMK_RGB_UNDERGLOW=y
CONFIG_WS2812_STRIP=y

# Allow toggling underglow without toggling external power
CONFIG_ZMK_RGB_UNDERGLOW_EXT_POWER=n

CONFIG_BUILD_OUTPUT_UF2=y

# Increase BLE power level
CONFIG_BT_CTLR_TX_PWR_PLUS_8=n

# Explicitly enable USB
CONFIG_ZMK_USB=y

# for logging, if needed ( https://zmk.dev/docs/development/usb-logging )
# uncomment for logging with delayed startup
# CONFIG_ZMK_USB_LOGGING=y
# CONFIG_LOG_PROCESS_THREAD_STARTUP_DELAY_MS=8000
# CONFIG_LOG_BUFFER_SIZE=16384

# This fixes an issue with some of my machines not being able to connect to ZMK
# https://discord.com/channels/719497620560543766/1196958410147639386/1203582993864720394
# Note to self: add to all my personal keyboard configs :)
# CONFIG_ZMK_BLE_EXPERIMENTAL_FEATURES=y
```

## boards/arm/ffkb_holyiot_v1_board/Kconfig.board
```kconfig
# Zaphod board configuration

# Copyright (c) 2020 Pete Johanson
# SPDX-License-Identifier: MIT

config BOARD_FFKB_HOLYIOT_V1_BOARD
	bool "ffkb_holyiot_v1_board"
	depends on SOC_NRF52840_QIAA
```

## boards/arm/ffkb_holyiot_v1_board/Kconfig.defconfig
```kconfig
# Copyright (c) 2020 Pete Johanson
# SPDX-License-Identifier: MIT

if BOARD_FFKB_HOLYIOT_V1_BOARD

config BOARD
	default "ffkb_holyiot_v1_board"

config ZMK_KEYBOARD_NAME
	default "ffkb_holyiot_v1"

if USB

config USB_NRFX
	default y

config USB_DEVICE_STACK
	default y

endif # USB

config BT_CTLR
	default BT

config ZMK_BLE
	default y

config ZMK_USB
	default y

config ZMK_BATTERY_VOLTAGE_DIVIDER
	default y

config BUILD_OUTPUT_UF2
	default y

endif # BOARD_FFKB_HOLYIOT_V1_BOARD
```

## boards/arm/ffkb_holyiot_v1_board/ffkb_holyiot_v1_board_defconfig
```kconfig
# SPDX-License-Identifier: MIT

CONFIG_USB_DEVICE_MANUFACTURER="fingerpunch"
CONFIG_ZMK_KEYBOARD_NAME="ffkb holyiot"
CONFIG_USB_DEVICE_PRODUCT="ffkb holyiot"
CONFIG_ZMK_HID_CONSUMER_REPORT_USAGES_FULL=y

CONFIG_SOC_SERIES_NRF52X=y
CONFIG_SOC_NRF52840_QIAA=y

# Enable MPU
CONFIG_ARM_MPU=y

# enable GPIO
CONFIG_GPIO=y

# for leds, if configured
CONFIG_SPI=y

CONFIG_ZMK_SLEEP=y

CONFIG_USE_DT_CODE_PARTITION=y

CONFIG_MPU_ALLOW_FLASH_WRITE=y
CONFIG_NVS=y
CONFIG_SETTINGS_NVS=y
CONFIG_FLASH=y
CONFIG_FLASH_PAGE_LAYOUT=y
CONFIG_FLASH_MAP=y

# Enable Encoders
CONFIG_EC11=n
CONFIG_EC11_TRIGGER_GLOBAL_THREAD=n

# Enable underglow
CONFIG_ZMK_RGB_UNDERGLOW=n
CONFIG_WS2812_STRIP=n

# Allow toggling underglow without toggling external power
CONFIG_ZMK_RGB_UNDERGLOW_EXT_POWER=n

CONFIG_BUILD_OUTPUT_UF2=y

# Increase BLE power level
CONFIG_BT_CTLR_TX_PWR_PLUS_8=y

# Explicitly enable USB
CONFIG_ZMK_USB=y
```

## boards/arm/pinkies_out_v3/Kconfig.board
```kconfig
# Copyright (c) 2024, Sadek Baroudi
# SPDX-License-Identifier: MIT

config BOARD_PINKIES_OUT_V3
    bool "pinkies_out_v3"
    depends on SOC_RP2040
```

## boards/arm/pinkies_out_v3/Kconfig.defconfig
```kconfig
# Copyright (c) 2024, Sadek Baroudi
# SPDX-License-Identifier: MIT

if BOARD_PINKIES_OUT_V3

config BOARD
    default "pinkies_out_v3"

config RP2_FLASH_W25Q080
    default y

endif # BOARD_PINKIES_OUT_V3
```

## boards/arm/tenbit/Kconfig.board
```kconfig
# Copyright (c) 2024 Pete Johanson
# SPDX-License-Identifier: MIT

config BOARD_TENBIT
	bool "tenbit"
	depends on SOC_STM32F411XE
	select ZMK_KSCAN_MATRIX_POLLING
```

## boards/arm/tenbit/Kconfig.defconfig
```kconfig
# Copyright (c) 2024 Pete Johanson
# SPDX-License-Identifier: MIT

if BOARD_TENBIT

config BOARD
	default "tenbit"

config ZMK_KEYBOARD_NAME
	default "tenbit"

config SPI_STM32_INTERRUPT
	default y
	depends on SPI

config BUILD_OUTPUT_UF2_USE_FLASH_BASE
	default y

config BUILD_OUTPUT_UF2_USE_FLASH_OFFSET
	default y

endif # BOARD_TENBIT
```

## boards/arm/tenbit/tenbit_defconfig
```kconfig
# Copyright (c) 2024 Pete Johanson
# SPDX-License-Identifier: MIT

CONFIG_BOARD_TENBIT=y
CONFIG_SOC_SERIES_STM32F4X=y
CONFIG_SOC_STM32F411XE=y

# Enable MPU
CONFIG_ARM_MPU=y

# Enable HW stack protection
CONFIG_HW_STACK_PROTECTION=y

# Enable GPIO
CONFIG_GPIO=y

# Clock configuration
CONFIG_CLOCK_CONTROL=y

# enable pin controller
CONFIG_PINCTRL=y

# ZMK Settings
CONFIG_ZMK_USB=y

# Bump this to keep things happy.
CONFIG_SYSTEM_WORKQUEUE_STACK_SIZE=2048

# Settings subsystem
CONFIG_SETTINGS=y
CONFIG_FLASH=y
CONFIG_FLASH_MAP=y
CONFIG_NVS=y
CONFIG_SETTINGS_NVS=y

CONFIG_ZMK_EXT_POWER=n
CONFIG_USB_SELF_POWERED=n

CONFIG_USE_DT_CODE_PARTITION=y
CONFIG_BUILD_OUTPUT_UF2=y
```

## boards/arm/vulpes_majora_v1/Kconfig.board
```kconfig
# Copyright (c) 2024, Sadek Baroudi
# SPDX-License-Identifier: MIT

config BOARD_VULPES_MAJORA_V1
    bool "vulpes_majora_v1"
    depends on SOC_RP2040
```

## boards/arm/vulpes_majora_v1_board/Kconfig.board
```kconfig
# Copyright (c) 2024, Sadek Baroudi
# SPDX-License-Identifier: MIT

config BOARD_VULPES_MAJORA_V1_BOARD
	bool "vulpes_majora_v1_board"
	depends on SOC_RP2040
```

## boards/arm/vulpes_majora_v1_board/Kconfig.defconfig
```kconfig
# Copyright (c) 2024, Sadek Baroudi
# SPDX-License-Identifier: MIT

if BOARD_VULPES_MAJORA_V1_BOARD

config BOARD
	default "vulpes_majora_v1_board"

config RP2_FLASH_W25Q080
	default y

endif # BOARD_VULPES_MAJORA_V1_BOARD
```

## boards/arm/vulpes_majora_v1_board/vulpes_majora_v1_board_defconfig
```kconfig
# Copyright (c) 2024, Sadek Baroudi
# SPDX-License-Identifier: MIT

CONFIG_USB_DEVICE_MANUFACTURER="fingerpunch"
CONFIG_ZMK_KEYBOARD_NAME="vulpes majora v1"
CONFIG_USB_DEVICE_PRODUCT="vulpes majora v1"
CONFIG_ZMK_HID_CONSUMER_REPORT_USAGES_FULL=y

CONFIG_SOC_SERIES_RP2XXX=y
CONFIG_SOC_RP2040=y
CONFIG_BOARD_VULPES_MAJORA_V1_BOARD=y

CONFIG_SYS_CLOCK_HW_CYCLES_PER_SEC=125000000

# Enable ZMK USB
CONFIG_ZMK_USB=y

# Enable GPIO
CONFIG_GPIO=y

# Enable reset driver
CONFIG_RESET=y

# Code partition needed to target the correct flash range
CONFIG_USE_DT_CODE_PARTITION=y

# Output UF2 by default, native bootloader supports it.
CONFIG_BUILD_OUTPUT_UF2=y

# for Shift Register and leds, if configured
CONFIG_SPI=y

# Enable Encoders
CONFIG_EC11=n
CONFIG_EC11_TRIGGER_GLOBAL_THREAD=n

# Enable underglow
CONFIG_ZMK_RGB_UNDERGLOW=y
CONFIG_WS2812_STRIP=y

# Allow toggling underglow without toggling external power
CONFIG_ZMK_RGB_UNDERGLOW_EXT_POWER=n
```

## boards/arm/ximi/Kconfig.board
```kconfig
# Copyright (c) 2021 Pete Johanson
# SPDX-License-Identifier: Apache-2.0

config BOARD_XIMI_LEFT
	bool "Ximi Left"
	depends on SOC_RP2040
# Include for double-tap bootloader, but need to switch to Pete's bootloader/retention-boot-mode-support branch
#	imply RETAINED_MEM
#	imply RETENTION
#	imply RETENTION_BOOT_MODE

config BOARD_XIMI_RIGHT
	bool "Ximi Right"
	depends on SOC_RP2040
# Include for double-tap bootloader, but need to switch to Pete's bootloader/retention-boot-mode-support branch
#	imply RETAINED_MEM
#	imply RETENTION
#	imply RETENTION_BOOT_MODE
```

## boards/arm/ximi/Kconfig.defconfig
```kconfig
# Copyright (c) 2021 Pete Johanson
# SPDX-License-Identifier: Apache-2.0

if BOARD_XIMI_LEFT

config BOARD
	default "ximi_left"

config RP2_FLASH_W25Q080
	default y

config ZMK_KEYBOARD_NAME
	default "Ximi"

endif # BOARD_XIMI_LEFT


if BOARD_XIMI_RIGHT

config BOARD
	default "ximi_right"

config RP2_FLASH_W25Q080
	default y

config ZMK_KEYBOARD_NAME
	default "Ximi (Right)"

endif # BOARD_XIMI_RIGHT
```

## boards/arm/ximi/ximi_right_defconfig
```kconfig
# SPDX-License-Identifier: Apache-2.0

CONFIG_SOC_SERIES_RP2XXX=y
CONFIG_SOC_RP2040=y
CONFIG_BOARD_XIMI_RIGHT=y

CONFIG_SYS_CLOCK_HW_CYCLES_PER_SEC=125000000

# Enable GPIO
CONFIG_GPIO=y

# Enable reset driver
CONFIG_RESET=y

# Code partition needed to target the correct flash range
CONFIG_USE_DT_CODE_PARTITION=y

# Output UF2 by default, native bootloader supports it.
CONFIG_BUILD_OUTPUT_UF2=y

# ZMK Specific
CONFIG_ZMK_USB=y

# Split
CONFIG_ZMK_SPLIT=y

# Settings Support
CONFIG_MPU_ALLOW_FLASH_WRITE=y
CONFIG_NVS=y
CONFIG_SETTINGS=y
CONFIG_SETTINGS_NVS=y
CONFIG_FLASH=y
CONFIG_FLASH_PAGE_LAYOUT=y
CONFIG_FLASH_MAP=y
```

## boards/arm/ximi_v2/Kconfig.board
```kconfig
# Copyright (c) 2024, Sadek Baroudi
# SPDX-License-Identifier: MIT

config BOARD_XIMI_V2
    bool "ximi_v2"
    depends on SOC_RP2040
```

## boards/arm/ximi_v2/Kconfig.defconfig
```kconfig
# Copyright (c) 2024, Sadek Baroudi
# SPDX-License-Identifier: MIT

if BOARD_XIMI_V2

config BOARD
    default "ximi_v2"

config RP2_FLASH_W25Q080
    default y

endif # BOARD_XIMI_V2
```

## boards/arm/ximi_v2/ximi_v2_defconfig
```kconfig
# Copyright (c) 2024, Sadek Baroudi
# SPDX-License-Identifier: MIT

CONFIG_USB_DEVICE_MANUFACTURER="fingerpunch"
CONFIG_ZMK_KEYBOARD_NAME="ximi v2"
CONFIG_USB_DEVICE_PRODUCT="ximi v2"
CONFIG_ZMK_HID_CONSUMER_REPORT_USAGES_FULL=y

# for logging, if needed ( https://zmk.dev/docs/development/usb-logging )
# uncomment for logging with delayed startup
CONFIG_ZMK_USB_LOGGING=y
CONFIG_LOG_PROCESS_THREAD_STARTUP_DELAY_MS=8000
CONFIG_LOG_BUFFER_SIZE=16384

CONFIG_SOC_SERIES_RP2XXX=y
CONFIG_SOC_RP2040=y
CONFIG_BOARD_XIMI_V2=y

CONFIG_SYS_CLOCK_HW_CYCLES_PER_SEC=125000000

# Enable ZMK USB
CONFIG_ZMK_USB=y

# Enable GPIO
CONFIG_GPIO=y

# Enable reset driver
CONFIG_RESET=y

# Code partition needed to target the correct flash range
CONFIG_USE_DT_CODE_PARTITION=y

# Output UF2 by default, native bootloader supports it.
CONFIG_BUILD_OUTPUT_UF2=y

# for Shift Register and leds, if configured
CONFIG_SPI=y

# # For audio buzzer
# CONFIG_PWM=y
# # https://discord.com/channels/939959680611020840/1189280494001606657/1246715087549628417
# CONFIG_PWM_INIT_PRIORITY=20

# Enable Encoders
CONFIG_EC11=n
CONFIG_EC11_TRIGGER_GLOBAL_THREAD=n

# Enable underglow
CONFIG_ZMK_RGB_UNDERGLOW=y
CONFIG_WS2812_STRIP=y

# Allow toggling underglow without toggling external power
CONFIG_ZMK_RGB_UNDERGLOW_EXT_POWER=n
```

## boards/fingerpunch/ffkb_holyiot_v1/Kconfig.ffkb_holyiot_v1
```kconfig
# Zaphod board configuration

# Copyright (c) 2020 Pete Johanson
# SPDX-License-Identifier: MIT

config BOARD_FFKB_HOLYIOT_V1
	select SOC_NRF52840_QIAA
	select ZMK_BOARD_COMPAT
	imply RETAINED_MEM
	imply RETENTION
	imply RETENTION_BOOT_MODE
```

## boards/fingerpunch/ffkb_holyiot_v1/board.yml
```yaml
board:
  name: ffkb_holyiot_v1
  vendor: fingerpunch
  socs:
    - name: nrf52840
```

## boards/fingerpunch/pinkies_out_v3/Kconfig.defconfig
```kconfig
# Copyright (c) 2024, Sadek Baroudi
# SPDX-License-Identifier: MIT

if BOARD_PINKIES_OUT_V3

config RP2_FLASH_W25Q080
    default y

endif # BOARD_PINKIES_OUT_V3
```

## boards/fingerpunch/pinkies_out_v3/Kconfig.pinkies_out_v3
```kconfig
# Copyright (c) 2024, Sadek Baroudi
# SPDX-License-Identifier: MIT

config BOARD_PINKIES_OUT_V3
    select SOC_RP2040
    imply RETAINED_MEM
    imply RETENTION
    imply RETENTION_BOOT_MODE
```
