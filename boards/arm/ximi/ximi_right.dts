/*
 * Copyright (c) 2021 Yonatan Schachter
 *
 * SPDX-License-Identifier: Apache-2.0
 */

#include "ximi.dtsi"

&default_transform {
	col-offset = <8>;
};

/ {
    // Right encoder
    encoder_2: encoder_2 {
        compatible = "alps,ec11";
        a-gpios = <&gpio0 7 (GPIO_ACTIVE_LOW | GPIO_PULL_UP)>;
        b-gpios = <&gpio0 8 (GPIO_ACTIVE_LOW | GPIO_PULL_UP)>;
        steps = <80>;
        status = "okay";
    };
};
