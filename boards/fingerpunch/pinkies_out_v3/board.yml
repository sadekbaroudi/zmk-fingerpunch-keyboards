## boards/fingerpunch/pinkies_out_v3/board.yml
```yaml
board:
  name: pinkies_out_v3
  vendor: fingerpunch
  revision:
    format: major.minor.patch
    default: 3.1.0
    exact: true
    revisions:
      - name: 3.0.0
      - name: 3.1.0
  socs:
    - name: rp2040
```

## boards/fingerpunch/vulpes_majora_v1/Kconfig.vulpes_majora_v1
```kconfig
# Copyright (c) 2024, Sadek Baroudi
# SPDX-License-Identifier: MIT

config BOARD_VULPES_MAJORA_V1
    select SOC_RP2040
    imply RETAINED_MEM
    imply RETENTION
    imply RETENTION_BOOT_MODE
```

## boards/fingerpunch/vulpes_majora_v1/board.yml
```yaml
board:
  name: vulpes_majora_v1
  vendor: fingerpunch
  socs:
    - name: rp2040
```

## boards/fingerpunch/ximi/Kconfig.defconfig
```kconfig
# Copyright (c) 2021 Pete Johanson
# SPDX-License-Identifier: Apache-2.0

if BOARD_XIMI_LEFT


config RP2_FLASH_W25Q080
	default y

config ZMK_KEYBOARD_NAME
	default "Ximi"

endif # BOARD_XIMI_LEFT


if BOARD_XIMI_RIGHT

config RP2_FLASH_W25Q080
	default y

config ZMK_KEYBOARD_NAME
	default "Ximi (Right)"

endif # BOARD_XIMI_RIGHT
```

## boards/fingerpunch/ximi/Kconfig.ximi_left
```kconfig
# Copyright (c) 2021 Pete Johanson
# SPDX-License-Identifier: Apache-2.0

config BOARD_XIMI_LEFT
	select SOC_RP2040
	imply RETAINED_MEM
	imply RETENTION
	imply RETENTION_BOOT_MODE
```

## boards/fingerpunch/ximi/Kconfig.ximi_right
```kconfig
# Copyright (c) 2021 Pete Johanson
# SPDX-License-Identifier: Apache-2.0

config BOARD_XIMI_RIGHT
	select SOC_RP2040
	select ZMK_BOARD_COMPAT
	imply RETAINED_MEM
	imply RETENTION
	imply RETENTION_BOOT_MODE
```

## boards/fingerpunch/ximi/board.yml
```yaml
boards:
  - name: ximi_left
    vendor: fingerpunch
    socs:
      - name: rp2040
    revision:
      format: major.minor.patch
      default: 2.0.0
      exact: true
      revisions:
        - name: 1.0.0
        - name: 2.0.0
  - name: ximi_right
    vendor: fingerpunch
    socs:
      - name: rp2040
    revision:
      format: major.minor.patch
      default: 2.0.0
      exact: true
      revisions:
        - name: 1.0.0
        - name: 2.0.0
```

## boards/shields/arachnophobe/Kconfig.defconfig
```kconfig
# Copyright (c) 2020 The ZMK Contributors
# SPDX-License-Identifier: MIT

if SHIELD_ARACHNOPHOBE

config ZMK_KEYBOARD_NAME
    default "arachnophobe"

if ZMK_BACKLIGHT

config LED_GPIO
    default y

endif # ZMK_BACKLIGHT

endif
```

## boards/shields/arachnophobe/Kconfig.shield
```kconfig
# Copyright (c) 2020 The ZMK Contributors
# SPDX-License-Identifier: MIT

config SHIELD_ARACHNOPHOBE
    def_bool $(shields_list_contains,arachnophobe)
```

## boards/shields/bykeeb/Kconfig.defconfig
```kconfig
# Copyright (c) 2024 Sadek Baroudi
# SPDX-License-Identifier: MIT

if SHIELD_BYKEEB_LEFT
config ZMK_KEYBOARD_NAME
    default "bykeeb"

config ZMK_SPLIT_ROLE_CENTRAL
    default y
endif

if SHIELD_BYKEEB_LEFT || SHIELD_BYKEEB_RIGHT
config ZMK_SPLIT
    default y
endif
```

## boards/shields/bykeeb/Kconfig.shield
```kconfig
# Copyright (c) 2024 Sadek Baroudi
# SPDX-License-Identifier: MIT

config SHIELD_BYKEEB_LEFT
    def_bool $(shields_list_contains,bykeeb_left)

config SHIELD_BYKEEB_RIGHT
    def_bool $(shields_list_contains,bykeeb_right)
```

## boards/shields/ffkb_holyiot_v1/Kconfig.defconfig
```kconfig
# Copyright (c) 2021 The ZMK Contributors
# SPDX-License-Identifier: MIT

if SHIELD_FFKB_HOLYIOT_V1

config ZMK_KEYBOARD_NAME
    default "ffkb_holyiot_v1"

CONFIG_BUILD_OUTPUT_UF2=y

endif
```

## boards/shields/ffkb_holyiot_v1/Kconfig.shield
```kconfig
# Copyright (c) 2021 The ZMK Contributors
# SPDX-License-Identifier: MIT

config SHIELD_FFKB_HOLYIOT_V1
    def_bool $(shields_list_contains,ffkb_holyiot_v1)
```

## boards/shields/ffkb_lite_v1/Kconfig.defconfig
```kconfig
# Copyright (c) 2021 The ZMK Contributors
# SPDX-License-Identifier: MIT

if SHIELD_FFKB_LITE_V1

config ZMK_KEYBOARD_NAME
    default "ffkb_lite_v1"

CONFIG_BUILD_OUTPUT_UF2=y

endif
```

## boards/shields/ffkb_v1/Kconfig.defconfig
```kconfig
# Copyright (c) 2021 The ZMK Contributors
# SPDX-License-Identifier: MIT

if SHIELD_FFKB_V1

config ZMK_KEYBOARD_NAME
    default "FFKB v1"

endif
```

## boards/shields/ffkb_v1/Kconfig.shield
```kconfig
# Copyright (c) 2021 The ZMK Contributors
# SPDX-License-Identifier: MIT

config SHIELD_FFKB_V1
    def_bool $(shields_list_contains,ffkb_v1)
```

## boards/shields/ffkb_v2/Kconfig.shield
```kconfig
# Copyright (c) 2021 The ZMK Contributors
# SPDX-License-Identifier: MIT

config SHIELD_FFKB_V2
    def_bool $(shields_list_contains,ffkb_v2)
```

## boards/shields/ffkb_v3/Kconfig.defconfig
```kconfig
# Copyright (c) 2021 The ZMK Contributors
# SPDX-License-Identifier: MIT

if SHIELD_FFKB_V3

config ZMK_KEYBOARD_NAME
    default "FFKB v3"

endif
```

## boards/shields/ffkb_we_v1/Kconfig.defconfig
```kconfig
# Copyright (c) 2021 The ZMK Contributors
# SPDX-License-Identifier: MIT

if SHIELD_FFKB_WE_V1

config ZMK_KEYBOARD_NAME
    default "ffkb_we_v1"

CONFIG_BUILD_OUTPUT_UF2=y

endif
```

## boards/shields/ffkb_we_v1/Kconfig.shield
```kconfig
# Copyright (c) 2021 The ZMK Contributors
# SPDX-License-Identifier: MIT

config SHIELD_FFKB_WE_V1
    def_bool $(shields_list_contains,ffkb_we_v1)
```

## boards/shields/helmet_head/Kconfig.defconfig
```kconfig
# Copyright (c) 2021 The ZMK Contributors
# SPDX-License-Identifier: MIT

if SHIELD_HELMET_HEAD

config ZMK_KEYBOARD_NAME
    default "helmet_head"

CONFIG_BUILD_OUTPUT_UF2=y

endif
```

## boards/shields/kucheza_byomcu/Kconfig.defconfig
```kconfig
# Copyright (c) 2021 The ZMK Contributors
# SPDX-License-Identifier: MIT

if SHIELD_KUCHEZA_BYOMCU

config ZMK_KEYBOARD_NAME
    default "kucheza"

endif
```

## boards/shields/kucheza_byomcu/Kconfig.shield
```kconfig
# Copyright (c) 2021 The ZMK Contributors
# SPDX-License-Identifier: MIT

config SHIELD_KUCHEZA_BYOMCU
    def_bool $(shields_list_contains,kucheza_byomcu)
```
