/*
 * Copyright (c) 2024 Sadek Baroudi
 *
 * SPDX-License-Identifier: MIT
 */

#include "bykeeb.dtsi"

&kscan0 {
    col-gpios
        = <&xiao_d 9 (GPIO_ACTIVE_HIGH)>
        , <&xiao_d 6 (GPIO_ACTIVE_HIGH)>
        , <&xiao_d 5 (GPIO_ACTIVE_HIGH)>
        , <&xiao_d 4 (GPIO_ACTIVE_HIGH)>
        , <&xiao_d 8 (GPIO_ACTIVE_HIGH)>
        ;
};