## boards/shields/pinkies_out_v1/Kconfig.defconfig
```kconfig
# Copyright (c) 2021 The ZMK Contributors
# SPDX-License-Identifier: MIT

if SHIELD_PINKIES_OUT_V1

config ZMK_KEYBOARD_NAME
    default "pinkies out v1"

endif
```

## boards/shields/pinkies_out_v2/Kconfig.defconfig
```kconfig
# Copyright (c) 2021 The ZMK Contributors
# SPDX-License-Identifier: MIT

if SHIELD_PINKIES_OUT_V2

config ZMK_KEYBOARD_NAME
    default "pinkies out v2"

endif
```

## boards/shields/pinkies_out_v2/Kconfig.shield
```kconfig
# Copyright (c) 2021 The ZMK Contributors
# SPDX-License-Identifier: MIT

config SHIELD_PINKIES_OUT_V2
    def_bool $(shields_list_contains,pinkies_out_v2)
```

## boards/shields/pinkiesout_v1/Kconfig.defconfig
```kconfig
# Copyright (c) 2021 The ZMK Contributors
# SPDX-License-Identifier: MIT

if SHIELD_PINKIESOUT_V1

config ZMK_KEYBOARD_NAME
    default "pinkiesout v1"

endif
```

## boards/shields/rock_on_v1/Kconfig.defconfig
```kconfig
# Copyright (c) 2021 The ZMK Contributors
# SPDX-License-Identifier: MIT

if SHIELD_ROCK_ON_V1

config ZMK_KEYBOARD_NAME
    default "rock on v1"

endif
```

## boards/shields/rock_on_v1/Kconfig.shield
```kconfig
# Copyright (c) 2021 The ZMK Contributors
# SPDX-License-Identifier: MIT

config SHIELD_ROCK_ON_V1
    def_bool $(shields_list_contains,rock_on_v1)
```

## boards/shields/rockon_v1/Kconfig.defconfig
```kconfig
# Copyright (c) 2021 The ZMK Contributors
# SPDX-License-Identifier: MIT

if SHIELD_ROCKON_V1

config ZMK_KEYBOARD_NAME
    default "rockon v1"

endif
```

## boards/shields/rockon_v1/Kconfig.shield
```kconfig
# Copyright (c) 2021 The ZMK Contributors
# SPDX-License-Identifier: MIT

config SHIELD_ROCKON_V1
    def_bool $(shields_list_contains,rockon_v1)
```

## boards/shields/vulpes_majora_v1/Kconfig.defconfig
```kconfig
# Copyright (c) 2021 The ZMK Contributors
# SPDX-License-Identifier: MIT

if SHIELD_VULPES_MAJORA_V1

config ZMK_KEYBOARD_NAME
    default "vulpes majora v1"

endif
```

## boards/shields/vulpes_majora_v1/Kconfig.shield
```kconfig
# Copyright (c) 2021 The ZMK Contributors
# SPDX-License-Identifier: MIT

config SHIELD_VULPES_MAJORA_V1
    def_bool $(shields_list_contains,vulpes_majora_v1)
```

## boards/shields/vulpes_minora/Kconfig.defconfig
```kconfig
# Copyright (c) 2022 The ZMK Contributors
# SPDX-License-Identifier: MIT

if SHIELD_VULPES_MINORA_LEFT

config ZMK_KEYBOARD_NAME
    default "vulpes minora"

config ZMK_SPLIT_ROLE_CENTRAL
    default y

endif

if SHIELD_VULPES_MINORA_LEFT || SHIELD_VULPES_MINORA_RIGHT

config ZMK_SPLIT
    default y

endif
```

## boards/shields/vulpes_minora/Kconfig.shield
```kconfig
# Copyright (c) 2022 The ZMK Contributors
# SPDX-License-Identifier: MIT

config SHIELD_VULPES_MINORA_LEFT
    def_bool $(shields_list_contains,vulpes_minora_left)

config SHIELD_VULPES_MINORA_RIGHT
    def_bool $(shields_list_contains,vulepes_minora_right)
```

## config/west.yml
```yaml
manifest:
  remotes:
    - name: zmkfirmware
      url-base: https://github.com/zmkfirmware
    - name: petejohanson
      url-base: https://github.com/petejohanson
    - name: sadekbaroudi
      url-base: https://github.com/sadekbaroudi
  projects:
    - name: zmk
      remote: zmkfirmware
      # Pinned to a validated ZMK main commit (2026-07-04) until ZMK tags v0.4.
      revision: 484a0547078228f6957ed164523823e39fbedec4
      import: app/west.yml
    - name: chiptuner-zmk-module
      remote: petejohanson
      revision: main
  self:
    path: config
    import: deps.yml
```
